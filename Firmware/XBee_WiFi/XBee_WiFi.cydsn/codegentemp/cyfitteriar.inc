#ifndef INCLUDED_CYFITTERIAR_INC
#define INCLUDED_CYFITTERIAR_INC

/* Blue_LED */
Blue_LED_0_DRIVEMODE EQU CY_GPIO_DM_STRONG_IN_OFF
Blue_LED_0_INBUF_ENABLED EQU 0
Blue_LED_0_INIT_DRIVESTATE EQU 1
Blue_LED_0_INIT_MUXSEL EQU 0
Blue_LED_0_INPUT_SYNC EQU 2
Blue_LED_0_INTERRUPT_MODE EQU CY_GPIO_INTR_DISABLE
Blue_LED_0_PORT EQU GPIO_PRT11
Blue_LED_0_SHIFT EQU 1
Blue_LED_0 EQU Blue_LED_0_PORT, Blue_LED_0_SHIFT
Blue_LED_0_SLEWRATE EQU CY_GPIO_SLEW_FAST
Blue_LED_0_THRESHOLD_LEVEL EQU CY_GPIO_VTRIP_CMOS

/* Pin_CM0p_Reading */
Pin_CM0p_Reading_0_DRIVEMODE EQU CY_GPIO_DM_STRONG_IN_OFF
Pin_CM0p_Reading_0_INBUF_ENABLED EQU 0
Pin_CM0p_Reading_0_INIT_DRIVESTATE EQU 0
Pin_CM0p_Reading_0_INIT_MUXSEL EQU 0
Pin_CM0p_Reading_0_INPUT_SYNC EQU 2
Pin_CM0p_Reading_0_INTERRUPT_MODE EQU CY_GPIO_INTR_DISABLE
Pin_CM0p_Reading_0_PORT EQU GPIO_PRT0
Pin_CM0p_Reading_0_SHIFT EQU 1
Pin_CM0p_Reading_0 EQU Pin_CM0p_Reading_0_PORT, Pin_CM0p_Reading_0_SHIFT
Pin_CM0p_Reading_0_SLEWRATE EQU CY_GPIO_SLEW_FAST
Pin_CM0p_Reading_0_THRESHOLD_LEVEL EQU CY_GPIO_VTRIP_CMOS

/* Pin_CM0p_Writing */
Pin_CM0p_Writing_0_DRIVEMODE EQU CY_GPIO_DM_STRONG_IN_OFF
Pin_CM0p_Writing_0_INBUF_ENABLED EQU 0
Pin_CM0p_Writing_0_INIT_DRIVESTATE EQU 0
Pin_CM0p_Writing_0_INIT_MUXSEL EQU 0
Pin_CM0p_Writing_0_INPUT_SYNC EQU 2
Pin_CM0p_Writing_0_INTERRUPT_MODE EQU CY_GPIO_INTR_DISABLE
Pin_CM0p_Writing_0_PORT EQU GPIO_PRT0
Pin_CM0p_Writing_0_SHIFT EQU 0
Pin_CM0p_Writing_0 EQU Pin_CM0p_Writing_0_PORT, Pin_CM0p_Writing_0_SHIFT
Pin_CM0p_Writing_0_SLEWRATE EQU CY_GPIO_SLEW_FAST
Pin_CM0p_Writing_0_THRESHOLD_LEVEL EQU CY_GPIO_VTRIP_CMOS

/* Pin_CM4_Reading */
Pin_CM4_Reading_0_DRIVEMODE EQU CY_GPIO_DM_STRONG_IN_OFF
Pin_CM4_Reading_0_INBUF_ENABLED EQU 0
Pin_CM4_Reading_0_INIT_DRIVESTATE EQU 0
Pin_CM4_Reading_0_INIT_MUXSEL EQU 0
Pin_CM4_Reading_0_INPUT_SYNC EQU 2
Pin_CM4_Reading_0_INTERRUPT_MODE EQU CY_GPIO_INTR_DISABLE
Pin_CM4_Reading_0_PORT EQU GPIO_PRT0
Pin_CM4_Reading_0_SHIFT EQU 5
Pin_CM4_Reading_0 EQU Pin_CM4_Reading_0_PORT, Pin_CM4_Reading_0_SHIFT
Pin_CM4_Reading_0_SLEWRATE EQU CY_GPIO_SLEW_FAST
Pin_CM4_Reading_0_THRESHOLD_LEVEL EQU CY_GPIO_VTRIP_CMOS

/* Pin_CM4_Writing */
Pin_CM4_Writing_0_DRIVEMODE EQU CY_GPIO_DM_STRONG_IN_OFF
Pin_CM4_Writing_0_INBUF_ENABLED EQU 0
Pin_CM4_Writing_0_INIT_DRIVESTATE EQU 0
Pin_CM4_Writing_0_INIT_MUXSEL EQU 0
Pin_CM4_Writing_0_INPUT_SYNC EQU 2
Pin_CM4_Writing_0_INTERRUPT_MODE EQU CY_GPIO_INTR_DISABLE
Pin_CM4_Writing_0_PORT EQU GPIO_PRT0
Pin_CM4_Writing_0_SHIFT EQU 4
Pin_CM4_Writing_0 EQU Pin_CM4_Writing_0_PORT, Pin_CM4_Writing_0_SHIFT
Pin_CM4_Writing_0_SLEWRATE EQU CY_GPIO_SLEW_FAST
Pin_CM4_Writing_0_THRESHOLD_LEVEL EQU CY_GPIO_VTRIP_CMOS

/* Red_LED */
Red_LED_0_DRIVEMODE EQU CY_GPIO_DM_STRONG_IN_OFF
Red_LED_0_INBUF_ENABLED EQU 0
Red_LED_0_INIT_DRIVESTATE EQU 1
Red_LED_0_INIT_MUXSEL EQU 0
Red_LED_0_INPUT_SYNC EQU 2
Red_LED_0_INTERRUPT_MODE EQU CY_GPIO_INTR_DISABLE
Red_LED_0_PORT EQU GPIO_PRT0
Red_LED_0_SHIFT EQU 3
Red_LED_0 EQU Red_LED_0_PORT, Red_LED_0_SHIFT
Red_LED_0_SLEWRATE EQU CY_GPIO_SLEW_FAST
Red_LED_0_THRESHOLD_LEVEL EQU CY_GPIO_VTRIP_CMOS

/* SPI */
SPI_miso_s_0_DRIVEMODE EQU CY_GPIO_DM_STRONG_IN_OFF
SPI_miso_s_0_INBUF_ENABLED EQU 0
SPI_miso_s_0_INIT_DRIVESTATE EQU 1
SPI_miso_s_0_INIT_MUXSEL EQU 20
SPI_miso_s_0_INPUT_SYNC EQU 2
SPI_miso_s_0_INTERRUPT_MODE EQU CY_GPIO_INTR_DISABLE
SPI_miso_s_0_PORT EQU GPIO_PRT12
SPI_miso_s_0_SHIFT EQU 1
SPI_miso_s_0 EQU SPI_miso_s_0_PORT, SPI_miso_s_0_SHIFT
SPI_miso_s_0_SLEWRATE EQU CY_GPIO_SLEW_FAST
SPI_miso_s_0_THRESHOLD_LEVEL EQU CY_GPIO_VTRIP_CMOS
SPI_mosi_s_0_DRIVEMODE EQU CY_GPIO_DM_ANALOG
SPI_mosi_s_0_INBUF_ENABLED EQU 1
SPI_mosi_s_0_INIT_DRIVESTATE EQU 1
SPI_mosi_s_0_INIT_MUXSEL EQU 20
SPI_mosi_s_0_INPUT_SYNC EQU 2
SPI_mosi_s_0_INTERRUPT_MODE EQU CY_GPIO_INTR_DISABLE
SPI_mosi_s_0_PORT EQU GPIO_PRT12
SPI_mosi_s_0_SHIFT EQU 0
SPI_mosi_s_0 EQU SPI_mosi_s_0_PORT, SPI_mosi_s_0_SHIFT
SPI_mosi_s_0_SLEWRATE EQU CY_GPIO_SLEW_FAST
SPI_mosi_s_0_THRESHOLD_LEVEL EQU CY_GPIO_VTRIP_CMOS
SPI_SCB__HW EQU SCB6
SPI_SCB__IDX EQU 6
SPI_SCB__SS0_POSITION EQU 0
SPI_SCB__SS1_POSITION EQU 1
SPI_SCB__SS2_POSITION EQU 2
SPI_SCB__SS3_POSITION EQU 3
SPI_SCB_IRQ__INTC_CORTEXM4_ASSIGNED EQU 1
SPI_SCB_IRQ__INTC_CORTEXM4_PRIORITY EQU 7
SPI_SCB_IRQ__INTC_NUMBER EQU 39
SPI_SCBCLK__DIV_IDX EQU 0
SPI_SCBCLK__DIV_NUM EQU 0
SPI_SCBCLK__DIV_TYPE EQU CY_SYSCLK_DIV_8_BIT
SPI_sclk_s_0_DRIVEMODE EQU CY_GPIO_DM_ANALOG
SPI_sclk_s_0_INBUF_ENABLED EQU 1
SPI_sclk_s_0_INIT_DRIVESTATE EQU 1
SPI_sclk_s_0_INIT_MUXSEL EQU 20
SPI_sclk_s_0_INPUT_SYNC EQU 2
SPI_sclk_s_0_INTERRUPT_MODE EQU CY_GPIO_INTR_DISABLE
SPI_sclk_s_0_PORT EQU GPIO_PRT12
SPI_sclk_s_0_SHIFT EQU 2
SPI_sclk_s_0 EQU SPI_sclk_s_0_PORT, SPI_sclk_s_0_SHIFT
SPI_sclk_s_0_SLEWRATE EQU CY_GPIO_SLEW_FAST
SPI_sclk_s_0_THRESHOLD_LEVEL EQU CY_GPIO_VTRIP_CMOS
SPI_ss_s_0_DRIVEMODE EQU CY_GPIO_DM_ANALOG
SPI_ss_s_0_INBUF_ENABLED EQU 1
SPI_ss_s_0_INIT_DRIVESTATE EQU 1
SPI_ss_s_0_INIT_MUXSEL EQU 20
SPI_ss_s_0_INPUT_SYNC EQU 2
SPI_ss_s_0_INTERRUPT_MODE EQU CY_GPIO_INTR_DISABLE
SPI_ss_s_0_PORT EQU GPIO_PRT12
SPI_ss_s_0_SHIFT EQU 3
SPI_ss_s_0 EQU SPI_ss_s_0_PORT, SPI_ss_s_0_SHIFT
SPI_ss_s_0_SLEWRATE EQU CY_GPIO_SLEW_FAST
SPI_ss_s_0_THRESHOLD_LEVEL EQU CY_GPIO_VTRIP_CMOS

/* UART */
UART_rx_0_DRIVEMODE EQU CY_GPIO_DM_ANALOG
UART_rx_0_INBUF_ENABLED EQU 1
UART_rx_0_INIT_DRIVESTATE EQU 1
UART_rx_0_INIT_MUXSEL EQU 18
UART_rx_0_INPUT_SYNC EQU 2
UART_rx_0_INTERRUPT_MODE EQU CY_GPIO_INTR_DISABLE
UART_rx_0_PORT EQU GPIO_PRT5
UART_rx_0_SHIFT EQU 0
UART_rx_0 EQU UART_rx_0_PORT, UART_rx_0_SHIFT
UART_rx_0_SLEWRATE EQU CY_GPIO_SLEW_FAST
UART_rx_0_THRESHOLD_LEVEL EQU CY_GPIO_VTRIP_CMOS
UART_SCB__HW EQU SCB5
UART_SCB__IDX EQU 5
UART_SCB__SS0_POSITION EQU 0
UART_SCB__SS1_POSITION EQU 1
UART_SCB__SS2_POSITION EQU 2
UART_SCB__SS3_POSITION EQU 3
UART_SCB_IRQ__INTC_CORTEXM4_ASSIGNED EQU 1
UART_SCB_IRQ__INTC_CORTEXM4_PRIORITY EQU 7
UART_SCB_IRQ__INTC_NUMBER EQU 38
UART_SCBCLK__DIV_IDX EQU 8
UART_SCBCLK__DIV_NUM EQU 0
UART_SCBCLK__DIV_TYPE EQU CY_SYSCLK_DIV_16_BIT
UART_tx_0_DRIVEMODE EQU CY_GPIO_DM_STRONG_IN_OFF
UART_tx_0_INBUF_ENABLED EQU 0
UART_tx_0_INIT_DRIVESTATE EQU 1
UART_tx_0_INIT_MUXSEL EQU 18
UART_tx_0_INPUT_SYNC EQU 2
UART_tx_0_INTERRUPT_MODE EQU CY_GPIO_INTR_DISABLE
UART_tx_0_PORT EQU GPIO_PRT5
UART_tx_0_SHIFT EQU 1
UART_tx_0 EQU UART_tx_0_PORT, UART_tx_0_SHIFT
UART_tx_0_SLEWRATE EQU CY_GPIO_SLEW_FAST
UART_tx_0_THRESHOLD_LEVEL EQU CY_GPIO_VTRIP_CMOS

/* White_Btn */
White_Btn_0_DRIVEMODE EQU CY_GPIO_DM_ANALOG
White_Btn_0_INBUF_ENABLED EQU 1
White_Btn_0_INIT_DRIVESTATE EQU 0
White_Btn_0_INIT_MUXSEL EQU 0
White_Btn_0_INPUT_SYNC EQU 2
White_Btn_0_INTERRUPT_MODE EQU CY_GPIO_INTR_DISABLE
White_Btn_0_PORT EQU GPIO_PRT13
White_Btn_0_SHIFT EQU 1
White_Btn_0 EQU White_Btn_0_PORT, White_Btn_0_SHIFT
White_Btn_0_SLEWRATE EQU CY_GPIO_SLEW_FAST
White_Btn_0_THRESHOLD_LEVEL EQU CY_GPIO_VTRIP_CMOS

/* Yellow_Btn */
Yellow_Btn_0_DRIVEMODE EQU CY_GPIO_DM_ANALOG
Yellow_Btn_0_INBUF_ENABLED EQU 1
Yellow_Btn_0_INIT_DRIVESTATE EQU 0
Yellow_Btn_0_INIT_MUXSEL EQU 0
Yellow_Btn_0_INPUT_SYNC EQU 2
Yellow_Btn_0_INTERRUPT_MODE EQU CY_GPIO_INTR_DISABLE
Yellow_Btn_0_PORT EQU GPIO_PRT0
Yellow_Btn_0_SHIFT EQU 2
Yellow_Btn_0 EQU Yellow_Btn_0_PORT, Yellow_Btn_0_SHIFT
Yellow_Btn_0_SLEWRATE EQU CY_GPIO_SLEW_FAST
Yellow_Btn_0_THRESHOLD_LEVEL EQU CY_GPIO_VTRIP_CMOS

/* Miscellaneous */
CPUSS_SWJ_SWCLK_TCLK_0_DRIVEMODE EQU CY_GPIO_DM_STRONG_IN_OFF
CPUSS_SWJ_SWCLK_TCLK_0_INBUF_ENABLED EQU 0
CPUSS_SWJ_SWCLK_TCLK_0_INIT_DRIVESTATE EQU 0
CPUSS_SWJ_SWCLK_TCLK_0_INIT_MUXSEL EQU 29
CPUSS_SWJ_SWCLK_TCLK_0_INPUT_SYNC EQU 2
CPUSS_SWJ_SWCLK_TCLK_0_INTERRUPT_MODE EQU CY_GPIO_INTR_DISABLE
CPUSS_SWJ_SWCLK_TCLK_0_PORT EQU GPIO_PRT6
CPUSS_SWJ_SWCLK_TCLK_0_SHIFT EQU 7
CPUSS_SWJ_SWCLK_TCLK_0 EQU CPUSS_SWJ_SWCLK_TCLK_0_PORT, CPUSS_SWJ_SWCLK_TCLK_0_SHIFT
CPUSS_SWJ_SWCLK_TCLK_0_SLEWRATE EQU CY_GPIO_SLEW_FAST
CPUSS_SWJ_SWCLK_TCLK_0_THRESHOLD_LEVEL EQU CY_GPIO_VTRIP_CMOS
CPUSS_SWJ_SWDIO_TMS_0_DRIVEMODE EQU CY_GPIO_DM_STRONG_IN_OFF
CPUSS_SWJ_SWDIO_TMS_0_INBUF_ENABLED EQU 0
CPUSS_SWJ_SWDIO_TMS_0_INIT_DRIVESTATE EQU 0
CPUSS_SWJ_SWDIO_TMS_0_INIT_MUXSEL EQU 29
CPUSS_SWJ_SWDIO_TMS_0_INPUT_SYNC EQU 2
CPUSS_SWJ_SWDIO_TMS_0_INTERRUPT_MODE EQU CY_GPIO_INTR_DISABLE
CPUSS_SWJ_SWDIO_TMS_0_PORT EQU GPIO_PRT6
CPUSS_SWJ_SWDIO_TMS_0_SHIFT EQU 6
CPUSS_SWJ_SWDIO_TMS_0 EQU CPUSS_SWJ_SWDIO_TMS_0_PORT, CPUSS_SWJ_SWDIO_TMS_0_SHIFT
CPUSS_SWJ_SWDIO_TMS_0_SLEWRATE EQU CY_GPIO_SLEW_FAST
CPUSS_SWJ_SWDIO_TMS_0_THRESHOLD_LEVEL EQU CY_GPIO_VTRIP_CMOS
CYDEV_BCLK__FASTCLK__HZ EQU 100000000
CYDEV_BCLK__FASTCLK__KHZ EQU 100000
CYDEV_BCLK__FASTCLK__MHZ EQU 100
CYDEV_BCLK__HFCLK0__HZ EQU 100000000
CYDEV_BCLK__HFCLK0__KHZ EQU 100000
CYDEV_BCLK__HFCLK0__MHZ EQU 100
CYDEV_BCLK__PERICLK__HZ EQU 50000000
CYDEV_BCLK__PERICLK__KHZ EQU 50000
CYDEV_BCLK__PERICLK__MHZ EQU 50
CYDEV_BCLK__SLOWCLK__HZ EQU 50000000
CYDEV_BCLK__SLOWCLK__KHZ EQU 50000
CYDEV_BCLK__SLOWCLK__MHZ EQU 50
CYDEV_CHIP_DIE_LEOPARD EQU 1
CYDEV_CHIP_DIE_PSOC4A EQU 16
CYDEV_CHIP_DIE_PSOC5LP EQU 2
CYDEV_CHIP_DIE_PSOC5TM EQU 3
CYDEV_CHIP_DIE_TMA4 EQU 4
CYDEV_CHIP_DIE_UNKNOWN EQU 0
CYDEV_CHIP_FAMILY_FM0P EQU 5
CYDEV_CHIP_FAMILY_FM3 EQU 6
CYDEV_CHIP_FAMILY_FM4 EQU 7
CYDEV_CHIP_FAMILY_PSOC3 EQU 1
CYDEV_CHIP_FAMILY_PSOC4 EQU 2
CYDEV_CHIP_FAMILY_PSOC5 EQU 3
CYDEV_CHIP_FAMILY_PSOC6 EQU 4
CYDEV_CHIP_FAMILY_UNKNOWN EQU 0
CYDEV_CHIP_FAMILY_USED EQU CYDEV_CHIP_FAMILY_PSOC6
CYDEV_CHIP_JTAG_ID EQU 0xE2011100
CYDEV_CHIP_MEMBER_3A EQU 1
CYDEV_CHIP_MEMBER_4A EQU 16
CYDEV_CHIP_MEMBER_4D EQU 12
CYDEV_CHIP_MEMBER_4E EQU 6
CYDEV_CHIP_MEMBER_4F EQU 17
CYDEV_CHIP_MEMBER_4G EQU 4
CYDEV_CHIP_MEMBER_4H EQU 15
CYDEV_CHIP_MEMBER_4I EQU 21
CYDEV_CHIP_MEMBER_4J EQU 13
CYDEV_CHIP_MEMBER_4K EQU 14
CYDEV_CHIP_MEMBER_4L EQU 20
CYDEV_CHIP_MEMBER_4M EQU 19
CYDEV_CHIP_MEMBER_4N EQU 9
CYDEV_CHIP_MEMBER_4O EQU 7
CYDEV_CHIP_MEMBER_4P EQU 18
CYDEV_CHIP_MEMBER_4Q EQU 11
CYDEV_CHIP_MEMBER_4R EQU 8
CYDEV_CHIP_MEMBER_4S EQU 10
CYDEV_CHIP_MEMBER_4U EQU 5
CYDEV_CHIP_MEMBER_5A EQU 3
CYDEV_CHIP_MEMBER_5B EQU 2
CYDEV_CHIP_MEMBER_6A EQU 22
CYDEV_CHIP_MEMBER_FM3 EQU 26
CYDEV_CHIP_MEMBER_FM4 EQU 27
CYDEV_CHIP_MEMBER_PDL_FM0P_TYPE1 EQU 23
CYDEV_CHIP_MEMBER_PDL_FM0P_TYPE2 EQU 24
CYDEV_CHIP_MEMBER_PDL_FM0P_TYPE3 EQU 25
CYDEV_CHIP_MEMBER_UNKNOWN EQU 0
CYDEV_CHIP_MEMBER_USED EQU CYDEV_CHIP_MEMBER_6A
CYDEV_CHIP_DIE_EXPECT EQU CYDEV_CHIP_MEMBER_USED
CYDEV_CHIP_DIE_ACTUAL EQU CYDEV_CHIP_DIE_EXPECT
CYDEV_CHIP_REV_LEOPARD_ES1 EQU 0
CYDEV_CHIP_REV_LEOPARD_ES2 EQU 1
CYDEV_CHIP_REV_LEOPARD_ES3 EQU 3
CYDEV_CHIP_REV_LEOPARD_PRODUCTION EQU 3
CYDEV_CHIP_REV_PSOC4A_ES0 EQU 17
CYDEV_CHIP_REV_PSOC4A_PRODUCTION EQU 17
CYDEV_CHIP_REV_PSOC5LP_ES0 EQU 0
CYDEV_CHIP_REV_PSOC5LP_PRODUCTION EQU 0
CYDEV_CHIP_REV_PSOC5TM_ES0 EQU 0
CYDEV_CHIP_REV_PSOC5TM_ES1 EQU 1
CYDEV_CHIP_REV_PSOC5TM_PRODUCTION EQU 1
CYDEV_CHIP_REV_TMA4_ES EQU 17
CYDEV_CHIP_REV_TMA4_ES2 EQU 33
CYDEV_CHIP_REV_TMA4_PRODUCTION EQU 17
CYDEV_CHIP_REVISION_3A_ES1 EQU 0
CYDEV_CHIP_REVISION_3A_ES2 EQU 1
CYDEV_CHIP_REVISION_3A_ES3 EQU 3
CYDEV_CHIP_REVISION_3A_PRODUCTION EQU 3
CYDEV_CHIP_REVISION_4A_ES0 EQU 17
CYDEV_CHIP_REVISION_4A_PRODUCTION EQU 17
CYDEV_CHIP_REVISION_4D_PRODUCTION EQU 0
CYDEV_CHIP_REVISION_4E_PRODUCTION EQU 0
CYDEV_CHIP_REVISION_4F_PRODUCTION EQU 0
CYDEV_CHIP_REVISION_4F_PRODUCTION_256DMA EQU 0
CYDEV_CHIP_REVISION_4F_PRODUCTION_256K EQU 0
CYDEV_CHIP_REVISION_4G_ES EQU 17
CYDEV_CHIP_REVISION_4G_ES2 EQU 33
CYDEV_CHIP_REVISION_4G_PRODUCTION EQU 17
CYDEV_CHIP_REVISION_4H_PRODUCTION EQU 0
CYDEV_CHIP_REVISION_4I_PRODUCTION EQU 0
CYDEV_CHIP_REVISION_4J_PRODUCTION EQU 0
CYDEV_CHIP_REVISION_4K_PRODUCTION EQU 0
CYDEV_CHIP_REVISION_4L_PRODUCTION EQU 0
CYDEV_CHIP_REVISION_4M_PRODUCTION EQU 0
CYDEV_CHIP_REVISION_4N_PRODUCTION EQU 0
CYDEV_CHIP_REVISION_4O_PRODUCTION EQU 0
CYDEV_CHIP_REVISION_4P_PRODUCTION EQU 0
CYDEV_CHIP_REVISION_4Q_PRODUCTION EQU 0
CYDEV_CHIP_REVISION_4R_PRODUCTION EQU 0
CYDEV_CHIP_REVISION_4S_PRODUCTION EQU 0
CYDEV_CHIP_REVISION_4U_PRODUCTION EQU 0
CYDEV_CHIP_REVISION_5A_ES0 EQU 0
CYDEV_CHIP_REVISION_5A_ES1 EQU 1
CYDEV_CHIP_REVISION_5A_PRODUCTION EQU 1
CYDEV_CHIP_REVISION_5B_ES0 EQU 0
CYDEV_CHIP_REVISION_5B_PRODUCTION EQU 0
CYDEV_CHIP_REVISION_6A_NO_UDB EQU 0
CYDEV_CHIP_REVISION_6A_PRODUCTION EQU 0
CYDEV_CHIP_REVISION_FM3_PRODUCTION EQU 0
CYDEV_CHIP_REVISION_FM4_PRODUCTION EQU 0
CYDEV_CHIP_REVISION_PDL_FM0P_TYPE1_PRODUCTION EQU 0
CYDEV_CHIP_REVISION_PDL_FM0P_TYPE2_PRODUCTION EQU 0
CYDEV_CHIP_REVISION_PDL_FM0P_TYPE3_PRODUCTION EQU 0
CYDEV_CHIP_REVISION_USED EQU CYDEV_CHIP_REVISION_6A_PRODUCTION
CYDEV_CHIP_REV_EXPECT EQU CYDEV_CHIP_REVISION_USED
CYDEV_CHIP_SECURITY_NORMAL EQU NORMAL
CYDEV_CHIP_SECURITY EQU CYDEV_CHIP_SECURITY_NORMAL
CYDEV_CHIP_SECURITY_SECURE EQU SECURE
CYDEV_CHIP_SECURITY_SECURE_WITH_DEBUG EQU SECURE_WITH_DEBUG
CYDEV_CONFIG_READ_ACCELERATOR EQU 1
CYDEV_CONFIG_UNUSED_IO_AllowButWarn EQU 0
CYDEV_CONFIG_UNUSED_IO EQU CYDEV_CONFIG_UNUSED_IO_AllowButWarn
CYDEV_CONFIG_UNUSED_IO_AllowWithInfo EQU 1
CYDEV_CONFIG_UNUSED_IO_Disallowed EQU 2
CYDEV_CONFIGURATION_COMPRESSED EQU 1
CYDEV_CONFIGURATION_MODE_COMPRESSED EQU 0
CYDEV_CONFIGURATION_MODE EQU CYDEV_CONFIGURATION_MODE_COMPRESSED
CYDEV_CONFIGURATION_MODE_DMA EQU 2
CYDEV_CONFIGURATION_MODE_UNCOMPRESSED EQU 1
CYDEV_CORE_VOLTAGE EQU CY_SYSPM_LDO_VOLTAGE_1_1V
CYDEV_DEBUGGING_DPS_Disable EQU 3
CYDEV_DEBUGGING_DPS_JTAG_4 EQU 1
CYDEV_DEBUGGING_DPS_JTAG_5 EQU 0
CYDEV_DEBUGGING_DPS_SWD EQU 2
CYDEV_DEBUGGING_DPS EQU CYDEV_DEBUGGING_DPS_SWD
CYDEV_DEBUGGING_DPS_SWD_SWV EQU 6
CYDEV_DEBUGGING_ENABLE EQU 1
CYDEV_ENABLE_SIMO_BUCK EQU false
CYDEV_IS_EXPORTING_CODE EQU 0
CYDEV_IS_IMPORTING_CODE EQU 0
CYDEV_POWER_MODE EQU CYDEV_POWER_MODE_LDO_LINEAR_REG_1_1V
CYDEV_PROJ_TYPE EQU 0
CYDEV_PROJ_TYPE_BOOTLOADER EQU 1
CYDEV_PROJ_TYPE_LAUNCHER EQU 5
CYDEV_PROJ_TYPE_LOADABLE EQU 2
CYDEV_PROJ_TYPE_LOADABLEANDBOOTLOADER EQU 4
CYDEV_PROJ_TYPE_MULTIAPPBOOTLOADER EQU 3
CYDEV_PROJ_TYPE_STANDARD EQU 0
CYDEV_SYSTEM_AREF_DEEPSLEEP EQU 0
CYDEV_SYSTEM_AREF_SOURCE EQU CYDEV_SYSTEM_AREF_SOURCE_0
CYDEV_VARIABLE_VDDA EQU 0
CYDEV_VBACKUP_MV EQU 3300
CYDEV_VDD_NS_MV EQU 3300
CYDEV_VDDA_MV EQU 3300
CYDEV_VDDD_MV EQU 3300
CYDEV_VDDIO0_MV EQU 3300
CYDEV_VDDIO1_MV EQU 3300
CYDEV_VDDR_HVL_MV EQU 3300
CYDEV_BOOTLOADER_ENABLE EQU 0

#endif /* INCLUDED_CYFITTERIAR_INC */
